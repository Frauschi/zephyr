## tests/net/lib/coap_server/common/testcase.yaml
```yaml
common:
  min_ram: 40
  min_flash: 180
  depends_on: netif
  tags:
    - net
    - coap
    - server
    - tls
  integration_platforms:
    - native_sim

tests:
  net.coap.server.secure: {}
  net.coap.server.secure.wolfssl:
    tags:
      - wolfssl
    platform_allow:
      - native_sim
      - native_sim/native/64
    integration_platforms:
      - native_sim/native/64
    extra_args:
      - OVERLAY_CONFIG=overlay-wolfssl.conf
```

## tests/net/lib/http_server/tls/testcase.yaml
```yaml
common:
  depends_on: netif
  min_ram: 192
  tags:
    - http
    - net
    - server
    - socket
tests:
  net.http.server.tls:
    platform_allow:
      - qemu_x86
    integration_platforms:
      - qemu_x86
  net.http.server.tls.toolchain:
    platform_allow:
      - native_sim
    integration_platforms:
      - native_sim
    integration_toolchains:
      - host
      - llvm
  net.http.server.tls.wolfssl:
    tags: wolfssl
    platform_allow:
      - native_sim
      - native_sim/native/64
    integration_platforms:
      - native_sim/native/64
    extra_args:
      - OVERLAY_CONFIG=overlay-wolfssl.conf
```

## tests/net/socket/register/testcase.yaml
```yaml
common:
  depends_on: netif
  tags:
    - net
    - socket
    - socket.register
tests:
  net.socket.register:
    extra_configs:
      - CONFIG_NET_SOCKETS_SOCKOPT_TLS=n
  net.socket.register.tls:
    extra_configs:
      - CONFIG_MBEDTLS=y
      - CONFIG_MBEDTLS_BUILTIN=y
      - CONFIG_MBEDTLS_ENABLE_HEAP=y
      - CONFIG_MBEDTLS_HEAP_SIZE=60000
      - CONFIG_MBEDTLS_SSL_MAX_CONTENT_LEN=2048
      - CONFIG_PSA_CRYPTO_ENABLE_ALL=n
      - CONFIG_MBEDTLS_USE_PSA_CRYPTO=n
      - CONFIG_NET_SOCKETS_SOCKOPT_TLS=y
      - CONFIG_NET_SOCKETS_TLS_MAX_CONTEXTS=6
      - CONFIG_NET_SOCKETS_ENABLE_DTLS=y
      - CONFIG_NET_SOCKETS_DTLS_TIMEOUT=30000
      - CONFIG_MAIN_STACK_SIZE=2048
  net.socket.register.tls.wolfssl:
    platform_allow:
      - native_sim
      - native_sim/native/64
    tags: net socket socket.register wolfssl
    extra_configs:
      - CONFIG_MBEDTLS=n
      - CONFIG_POSIX_API=y
      - CONFIG_POSIX_TIMERS=y
      - CONFIG_POSIX_THREADS=y
      - CONFIG_WOLFSSL=y
      - CONFIG_WOLFSSL_DTLS=y
      - CONFIG_COMMON_LIBC_MALLOC_ARENA_SIZE=65536
      - CONFIG_NET_SOCKETS_SOCKOPT_TLS=y
      - CONFIG_NET_SOCKETS_TLS_MAX_CONTEXTS=6
      - CONFIG_NET_SOCKETS_ENABLE_DTLS=y
      - CONFIG_NET_SOCKETS_DTLS_TIMEOUT=30000
      - CONFIG_MAIN_STACK_SIZE=2048
```
