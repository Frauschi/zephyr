## tests/net/lib/tls_credentials/testcase.yaml
```yaml
tests:
  net.tls_credentials:
    tags:
      - net
      - tls
    depends_on: netif
  net.tls_credentials.trusted_tfm:
    filter: CONFIG_BUILD_WITH_TFM
    extra_args: EXTRA_CONF_FILE=./prj_trusted_tfm.conf
    tags:
      - net
      - tls
      - trusted-firmware-m
  net.tls_credentials.wolfssl:
    # Catches symbol clashes between a WOLFSSL=y build and the credentials API
    tags:
      - net
      - tls
      - wolfssl
    depends_on: netif
    platform_allow:
      - native_sim
      - native_sim/native/64
    integration_platforms:
      - native_sim/native/64
    extra_configs:
      - CONFIG_MBEDTLS=n
      - CONFIG_POSIX_API=y
      - CONFIG_POSIX_TIMERS=y
      - CONFIG_POSIX_THREADS=y
      - CONFIG_WOLFSSL=y
      - CONFIG_COMMON_LIBC_MALLOC_ARENA_SIZE=65536
```

## tests/net/socket/tls/testcase.yaml
```yaml
common:
  depends_on: netif
  min_ram: 32
  min_flash: 260
  tags:
    - net
    - socket
    - tls
  filter: CONFIG_FULL_LIBC_SUPPORTED
  integration_platforms:
    - qemu_x86
  platform_exclude: vmu_rt1170/mimxrt1176/cm7 # See #61129
tests:
  net.socket.tls:
    extra_configs:
      - CONFIG_NET_TC_THREAD_COOPERATIVE=y
  net.socket.tls.preempt:
    extra_configs:
      - CONFIG_NET_TC_THREAD_PREEMPTIVE=y
    platform_exclude: mps2/an385
  net.socket.tls.sendmsg_no_buf:
    extra_configs:
      - CONFIG_NET_SOCKETS_DTLS_SENDMSG_BUF_SIZE=0
  net.socket.tls.wolfssl:
    platform_allow:
      - native_sim
      - native_sim/native/64
    integration_platforms:
      - native_sim
    tags: wolfssl
    extra_args:
      - EXTRA_CONF_FILE=overlay-wolfssl.conf
  net.socket.tls.wolfssl_ocsp_stapling:
    platform_allow:
      - native_sim
      - native_sim/native/64
    integration_platforms:
      - native_sim
    tags: wolfssl
    extra_args:
      - EXTRA_CONF_FILE=overlay-wolfssl.conf
    extra_configs:
      - CONFIG_NET_SOCKETS_TLS_WOLFSSL_OCSP_STAPLING=y
  # Build-only: must-staple fails every handshake here, because the test's
  # own TLS server has no OCSP response to staple.
  net.socket.tls.wolfssl_ocsp_must_staple:
    build_only: true
    platform_allow:
      - native_sim
      - native_sim/native/64
    integration_platforms:
      - native_sim
    tags: wolfssl
    extra_args:
      - EXTRA_CONF_FILE=overlay-wolfssl.conf
    extra_configs:
      - CONFIG_NET_SOCKETS_TLS_WOLFSSL_OCSP_STAPLING=y
      - CONFIG_NET_SOCKETS_TLS_WOLFSSL_OCSP_MUST_STAPLE=y
```

## tests/net/socket/tls_ext/testcase.yaml
```yaml
common:
  tags:
    - net
    - socket
    - tls
tests:
  net.socket.tls.ext:
    platform_allow: qemu_x86
    integration_platforms:
      - qemu_x86

  net.socket.tls.ext.wolfssl:
    platform_allow:
      - native_sim
      - native_sim/native/64
    tags: wolfssl
    extra_args:
      - EXTRA_CONF_FILE=overlay-wolfssl.conf

  net.socket.tls.ext.wolfssl.build.tls13_only:
    build_only: true
    platform_allow:
      - native_sim
      - native_sim/native/64
    tags: wolfssl
    extra_args:
      - EXTRA_CONF_FILE=overlay-wolfssl.conf
    extra_configs:
      - CONFIG_WOLFSSL_TLS_VERSION_1_2=n
  net.socket.tls.ext.wolfssl.build.client_only:
    build_only: true
    platform_allow:
      - native_sim
      - native_sim/native/64
    tags: wolfssl
    extra_args:
      - EXTRA_CONF_FILE=overlay-wolfssl.conf
    extra_configs:
      - CONFIG_COMPILER_OPT="-DNO_WOLFSSL_SERVER"
  net.socket.tls.ext.wolfssl.build.server_only:
    build_only: true
    platform_allow:
      - native_sim
      - native_sim/native/64
    tags: wolfssl
    extra_args:
      - EXTRA_CONF_FILE=overlay-wolfssl.conf
    extra_configs:
      - CONFIG_COMPILER_OPT="-DNO_WOLFSSL_CLIENT"
  net.socket.tls.ext.wolfssl.ocsp_stapling:
    platform_allow:
      - native_sim
      - native_sim/native/64
    tags: wolfssl
    extra_args:
      - EXTRA_CONF_FILE=overlay-wolfssl.conf
    extra_configs:
      - CONFIG_TLS_MAX_CREDENTIALS_NUMBER=9
      - CONFIG_NET_SOCKETS_TLS_WOLFSSL_OCSP_STAPLING=y
  net.socket.tls.ext.wolfssl.ocsp_must_staple:
    platform_allow:
      - native_sim
      - native_sim/native/64
    tags: wolfssl
    extra_args:
      - EXTRA_CONF_FILE=overlay-wolfssl.conf
    extra_configs:
      - CONFIG_TLS_MAX_CREDENTIALS_NUMBER=9
      - CONFIG_NET_SOCKETS_TLS_WOLFSSL_OCSP_STAPLING=y
      - CONFIG_NET_SOCKETS_TLS_WOLFSSL_OCSP_MUST_STAPLE=y
      - CONFIG_ZTEST_VERIFY_RUN_ALL=n
  net.socket.tls.ext.wolfssl.dtls:
    platform_allow:
      - native_sim
      - native_sim/native/64
    tags: wolfssl
    extra_args:
      - EXTRA_CONF_FILE=overlay-wolfssl.conf
    extra_configs:
      - CONFIG_NET_UDP=y
      - CONFIG_NET_SOCKETS_ENABLE_DTLS=y
      - CONFIG_NET_SOCKETS_TLS_MAX_SESSION_CONTEXTS=4
      - CONFIG_WOLFSSL_DTLS=y
  net.socket.tls.ext.wolfssl.renegotiation:
    platform_allow:
      - native_sim
      - native_sim/native/64
    tags: wolfssl
    extra_args:
      - EXTRA_CONF_FILE=overlay-wolfssl-verify-cb.conf
    extra_configs:
      - CONFIG_COMPILER_OPT="-DHAVE_SECURE_RENEGOTIATION"
  net.socket.tls.ext.wolfssl.verify_cb:
    platform_allow:
      - native_sim
      - native_sim/native/64
    tags: wolfssl
    extra_args:
      - EXTRA_CONF_FILE=overlay-wolfssl-verify-cb.conf
```
