## prj.conf
```kconfig
# Setup for self-contained net testing without requiring a SLIP driver
CONFIG_SMP=n
CONFIG_NET_TEST=y

# General config
CONFIG_REQUIRES_FULL_LIBC=y

# Networking config
CONFIG_NETWORKING=y
CONFIG_NET_IPV4=y
CONFIG_NET_IPV6=y
CONFIG_NET_TCP=y
CONFIG_NET_UDP=y
CONFIG_NET_SOCKETS=y
CONFIG_NET_SOCKETS_SOCKOPT_TLS=y
CONFIG_NET_SOCKETS_ENABLE_DTLS=y
CONFIG_NET_SOCKETS_DTLS_SENDMSG_BUF_SIZE=128
CONFIG_NET_SOCKETS_TLS_MAX_CONTEXTS=4
CONFIG_TLS_MAX_CREDENTIALS_NUMBER=10
CONFIG_NET_CONTEXT_RCVTIMEO=y
CONFIG_NET_CONTEXT_SNDTIMEO=y
CONFIG_NET_CONTEXT_RCVBUF=y
CONFIG_ZVFS_OPEN_ADD_SIZE_NET=10

# Keep timings short for the test
CONFIG_NET_TCP_TIME_WAIT_DELAY=10
CONFIG_NET_SOCKETS_CONNECT_TIMEOUT=200
CONFIG_NET_SOCKETS_DTLS_TIMEOUT=2000

# Network driver config
CONFIG_NET_DRIVERS=y
CONFIG_NET_LOOPBACK=y
CONFIG_NET_LOOPBACK_SIMULATE_PACKET_DROP=y
CONFIG_TEST_RANDOM_GENERATOR=y

CONFIG_MAIN_STACK_SIZE=2048
CONFIG_TEST_USERSPACE=y

# The test requires lot of bufs
CONFIG_NET_MAX_CONTEXTS=20
CONFIG_NET_PKT_TX_COUNT=24
CONFIG_NET_PKT_RX_COUNT=24
CONFIG_NET_BUF_TX_COUNT=32
CONFIG_NET_BUF_RX_COUNT=32

CONFIG_ZTEST=y
CONFIG_ZTEST_STACK_SIZE=4096

CONFIG_MBEDTLS_ENABLE_HEAP=y
# Upstream's 18000 is too small for the added tests, some of which hold three DTLS sessions
CONFIG_MBEDTLS_HEAP_SIZE=28000
CONFIG_MBEDTLS_KEY_EXCHANGE_PSK_ENABLED=y
CONFIG_MBEDTLS_HASH_ALL_ENABLED=y
CONFIG_MBEDTLS_CMAC=y
CONFIG_MBEDTLS_SSL_ALPN=y
CONFIG_NET_SOCKETS_TLS_MAX_APP_PROTOCOLS=3
```

## overlay-wolfssl.conf
```kconfig
# Copyright (c) 2026 wolfSSL Inc.
# SPDX-License-Identifier: Apache-2.0

CONFIG_MBEDTLS=n
CONFIG_POSIX_API=y
CONFIG_POSIX_TIMERS=y
CONFIG_POSIX_THREADS=y
CONFIG_WOLFSSL=y
CONFIG_WOLFSSL_DTLS=y
CONFIG_COMMON_LIBC_MALLOC_ARENA_SIZE=131072
CONFIG_WOLFSSL_ALPN=y
CONFIG_WOLFSSL_PSK=y
CONFIG_MBEDTLS_ENABLE_HEAP=n
CONFIG_MBEDTLS_KEY_EXCHANGE_PSK_ENABLED=n
CONFIG_MBEDTLS_HASH_ALL_ENABLED=n
CONFIG_MBEDTLS_CMAC=n
CONFIG_MBEDTLS_SSL_ALPN=n
CONFIG_WOLFSSL_TLS_VERSION_1_3=y
CONFIG_WOLFSSL_SESSION_EXPORT=y
CONFIG_WOLFSSL_ALWAYS_VERIFY_CB=y
CONFIG_ZTEST_STACK_SIZE=16384
CONFIG_NET_SOCKETS_CONNECT_TIMEOUT=2000
```

## prj_wolfssl.conf
```kconfig
# Copyright (c) 2026 wolfSSL Inc.
# SPDX-License-Identifier: Apache-2.0
#
# A full CONF_FILE rather than an overlay, so prj.conf's mbedTLS options need no override.
# check_conf_sync.py, run by hand, reports where the backend-neutral part drifts from prj.conf.

# Setup for self-contained net testing without requiring a SLIP driver
CONFIG_SMP=n
CONFIG_NET_TEST=y

# General config
CONFIG_REQUIRES_FULL_LIBC=y

# Networking config
CONFIG_NETWORKING=y
CONFIG_NET_IPV4=y
CONFIG_NET_IPV6=y
CONFIG_NET_TCP=y
CONFIG_NET_UDP=y
CONFIG_NET_SOCKETS=y
CONFIG_NET_SOCKETS_SOCKOPT_TLS=y
CONFIG_NET_SOCKETS_ENABLE_DTLS=y
CONFIG_NET_SOCKETS_DTLS_SENDMSG_BUF_SIZE=128
CONFIG_NET_SOCKETS_TLS_MAX_CONTEXTS=4
CONFIG_TLS_MAX_CREDENTIALS_NUMBER=10
CONFIG_NET_CONTEXT_RCVTIMEO=y
CONFIG_NET_CONTEXT_SNDTIMEO=y
CONFIG_NET_CONTEXT_RCVBUF=y
CONFIG_ZVFS_OPEN_ADD_SIZE_NET=10

# Keep timings short for the test
CONFIG_NET_TCP_TIME_WAIT_DELAY=10
CONFIG_NET_SOCKETS_CONNECT_TIMEOUT=200
CONFIG_NET_SOCKETS_TLS_CONNECT_TIMEOUT=2000
CONFIG_NET_SOCKETS_DTLS_TIMEOUT=1000

# Network driver config
CONFIG_NET_DRIVERS=y
CONFIG_NET_LOOPBACK=y
CONFIG_NET_LOOPBACK_SIMULATE_PACKET_DROP=y
CONFIG_TEST_RANDOM_GENERATOR=y

CONFIG_MAIN_STACK_SIZE=4096
CONFIG_TEST_USERSPACE=y

# The test requires lot of bufs
CONFIG_NET_MAX_CONTEXTS=20
CONFIG_NET_PKT_TX_COUNT=24
CONFIG_NET_PKT_RX_COUNT=24
CONFIG_NET_BUF_TX_COUNT=32
CONFIG_NET_BUF_RX_COUNT=32

CONFIG_ZTEST=y
CONFIG_ZTEST_STACK_SIZE=16384

# wolfSSL backend
CONFIG_MBEDTLS=n
CONFIG_POSIX_API=y
CONFIG_POSIX_TIMERS=y
CONFIG_POSIX_THREADS=y
CONFIG_WOLFSSL=y
CONFIG_WOLFSSL_DTLS=y
CONFIG_WOLFSSL_ALPN=y
CONFIG_WOLFSSL_PSK=y
CONFIG_WOLFSSL_TLS_VERSION_1_3=y
CONFIG_WOLFSSL_SESSION_EXPORT=y
CONFIG_WOLFSSL_ALWAYS_VERIFY_CB=y
CONFIG_COMMON_LIBC_MALLOC_ARENA_SIZE=131072
CONFIG_NET_SOCKETS_TLS_MAX_APP_PROTOCOLS=3
CONFIG_NET_CONTEXT_REUSEPORT=y
CONFIG_NET_CONTEXT_RECV_PKTINFO=y
```

## src/wolfssl_alert.c
```c
/*
 * Copyright (c) 2026 wolfSSL Inc.
 *
 * SPDX-License-Identifier: Apache-2.0
 */

/* Keeps <wolfssl/internal.h> and its unprefixed names out of main.c */

#if defined(CONFIG_WOLFSSL)

#ifndef WOLFSSL_USER_SETTINGS
#include <user_settings.h>
#endif
#include <wolfssl/internal.h>

void test_wolfssl_send_fatal_alert(WOLFSSL *ssl)
{
	(void)SendAlert(ssl, alert_fatal, wolfssl_alert_protocol_version);
}

void test_wolfssl_mark_close_notify_sent(WOLFSSL *ssl)
{
	ssl->options.sentNotify = 1;
}

int test_wolfssl_max_psk_id_len(void)
{
	return MAX_PSK_ID_LEN;
}

#ifdef WOLFSSL_DTLS
int test_wolfssl_dtls_timeout_max(WOLFSSL *ssl)
{
	return ssl->dtls_timeout_max;
}
#endif /* WOLFSSL_DTLS */

#endif /* CONFIG_WOLFSSL */
```
